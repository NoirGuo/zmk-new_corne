## boards/arm/wingxsl/Kconfig.board
```kconfig
#
# Copyright (c) 2024 The ZMK Contributors
# SPDX-License-Identifier: MIT
#

config BOARD_WINGXSL_LEFT
    bool "wingxsl left"
    depends on SOC_NRF52840_QIAA

config BOARD_WINGXSL_RIGHT
    bool "wingxsl right"
    depends on SOC_NRF52840_QIAA
```
